## configs/bittboy_defconfig
```kconfig
BR2_arm=y
BR2_STATIC_LIBS=y
BR2_TOOLCHAIN_BUILDROOT_MUSL=y
BR2_KERNEL_HEADERS_4_14=y
BR2_BINUTILS_VERSION_2_35_X=y
BR2_GCC_VERSION_11_X=y
BR2_TOOLCHAIN_BUILDROOT_CXX=y
BR2_GCC_ENABLE_LTO=y
BR2_TARGET_OPTIMIZATION="-fno-PIC -march=armv5te -mtune=arm926ej-s"
BR2_TARGET_LDFLAGS="-lc -no-pie"
BR2_PACKAGE_ALSA_UTILS=y
BR2_PACKAGE_FFMPEG=y
BR2_PACKAGE_FLUIDLITE=y
BR2_PACKAGE_MPG123=y
BR2_PACKAGE_BZIP2=y
BR2_PACKAGE_SDL_GFX=y
BR2_PACKAGE_SDL_IMAGE=y
BR2_PACKAGE_SDL_IMAGE_GIF=y
BR2_PACKAGE_SDL_IMAGE_JPEG=y
BR2_PACKAGE_SDL_IMAGE_PCX=y
BR2_PACKAGE_SDL_IMAGE_PNG=y
BR2_PACKAGE_SDL_MIXER=y
BR2_PACKAGE_SDL_NET=y
BR2_PACKAGE_SDL_SOUND=y
BR2_PACKAGE_SDL_TTF=y
BR2_PACKAGE_LIBMIKMOD=y
BR2_PACKAGE_LIBSAMPLERATE=y
BR2_PACKAGE_LIBSNDFILE=y
BR2_PACKAGE_LIBVORBIS=y
BR2_PACKAGE_OPENAL=y
BR2_PACKAGE_PORTAUDIO=y
BR2_PACKAGE_TREMOR=y
BR2_PACKAGE_AGG=y
BR2_PACKAGE_PIXMAN=y
BR2_PACKAGE_EXPAT=y
BR2_PACKAGE_FMT=y
```

## package/libmikmod/Config.in
```kconfig
config BR2_PACKAGE_LIBMIKMOD
	bool "libmikmod"
	depends on BR2_PACKAGE_SDL
	help
	  Mikmod is a module player and library supporting many
	  tracker formats, including mod, s3m, it, and xm.

	  http://mikmod.shlomifish.org/
```
